/* custom.ld */
SECTIONS {
    /* テキストセクション (コード) */
    . = 0x00000000;
    .text : {
        *(.text)        /* .textセクションを配置 */
        *(.text.*)      /* 他の .text.* セクションも含む */
    }

    /* 初期化済みデータセクション */
    . = ALIGN(4);       /* 4バイトアラインメント */
    .data : {
        *(.data)        /* .dataセクションを配置 */
        *(.data.*)      /* 他の .data.* セクションも含む */
    }

    /* BSS セクション (初期化されていないデータ) */
    . = ALIGN(4);       /* 4バイトアラインメント */
    .bss : {
        *(.bss)         /* .bssセクションを配置 */
        *(.bss.*)       /* 他の .bss.* セクションも含む */
    }
}
